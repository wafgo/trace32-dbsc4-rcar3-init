ENTRY %LINE &p
WinCLEAR

RESet
SYStem.RESet
SYStem.CPU R8A77960
SYStem.JtagClock CTCK 10MHz
CORE.ASSIGN 1.    ; select only master core 1 - 1. first core, 2. second core, 1. 2. first + second core (SMP) ...
SYStem.Up

Data.Set AD:0xE67F0018 %LE %Long 0x1

Trace.DISable

IF STRING.SCAN("&p", "BL2=",0)==-1
(
    GOSUB print_args
)

&bl2=STRing.SCANAndExtract("&p", "BL2=", "../../build/rcar/debug/bl2/bl2.elf")
Data.LOAD.Elf &bl2
WinCLEAR
Mode.Hll

do window_config

Go.direct InitDram
WAIT !STATE.RUN()


B::

Break.RESet
Break.CONFIG.VarConvert OFF
Break.CONFIG.InexactData ON
Break.CONFIG.InexactTrigger OFF
Break.CONFIG.InexactResume ON
Break.CONFIG.InexactAddress ON
Break.CONFIG.UseContextID OFF
Break.CONFIG.UseMachineID OFF
Break.CONFIG.MatchASID OFF
Break.CONFIG.MatchMachine OFF
Break.CONFIG.MatchZone OFF

APPEND ./mem_access_gen.c "static const struct mem_access mm_acc[] = {"
//Hack to avoid running into problems when booting from SCIF2 using debugger
Break.Set rcar_bl2_early_platform_setup\295 /Program /CMD "APPEND ./mem_access_gen.c ""};"""
//Break.Set     mmio_read_32\1 /Program /CMD "APPEND ./mmio_access_gen.cmm ""&tval=Data.Long(A:0x"" VAR.VALUE(addr) "")""" /RESUME
//Break.Set     mmio_write_32\1 /Program /CMD "APPEND ./mmio_access_gen.cmm ""Data.Set AD:0x"" VAR.VALUE(addr) "" %LE %Long 0x"" VAR.VALUE(value)" /RESUME

Break.Set     mmio_read_32\1 /Program /CMD "APPEND ./mem_access_gen.cmm ""1 0x""  VAR.VALUE(addr) "" 0x0""" /CMD "APPEND ./mem_access_gen.c ""{.rnw = 1, .addr = 0x"" VAR.VALUE(addr) "", .data = 0x0 },"" " /RESUME
Break.Set     mmio_write_32\1 /Program /CMD "APPEND ./mem_access_gen.cmm ""0 0x"" VAR.VALUE(addr) "" 0x"" VAR.VALUE(value)" /CMD "APPEND ./mem_access_gen.c ""{.rnw = 0, .addr = 0x"" VAR.VALUE(addr) "", .data = 0x"" VAR.VALUE(value) ""},"" " /RESUME
Go

ENDDO

print_args:
    PRINT "Usage:"
    PRINT
    PRINT "do dram_init_generate.cmm BL2=<bl2> "
    PRINT "Where:"
    PRINT " <bl2> is the location of the ATF bl2 elf file"
    PRINT "Script will complete using default values."
RETURN

